## main/Kconfig.projbuild
```kconfig
# Kconfig for PC Monitor Project

menu "PC Monitor Configuration"

    config LVGL_CONF_INCLUDE_SIMPLE
        bool
        default y
        help
            Enable simple include of lv_conf.h

endmenu
```

## sdkconfig.defaults
```kconfig
# ============================================================================
# PC Monitor - LVGL Configuration for ESP32-S3 N16R8 with PSRAM
# ============================================================================

# ESP32-S3 with Octal PSRAM (8MB)
CONFIG_IDF_TARGET="esp32s3"
CONFIG_ESP32S3_SPIRAM_SUPPORT=y
CONFIG_SPIRAM_MODE_OCT=y
CONFIG_SPIRAM=y

# PSRAM Configuration (40M matches the validated live sdkconfig; 80M is
# possible on N16R8 but untested on this build - do not change blindly,
# a non-booting config cannot be fixed via serial FW update!)
CONFIG_SPIRAM_SPEED_40M=y
CONFIG_SPIRAM_BOOT_INIT=y
CONFIG_SPIRAM_USE_MALLOC=y
CONFIG_SPIRAM_MALLOC_ALWAYSINTERNAL=0
CONFIG_SPIRAM_TRY_ALLOCATE_WIFI_LWIP=y

# Memory allocation strategy
CONFIG_SPIRAM_MEMTEST=y
CONFIG_SPIRAM_MALLOC_RESERVE_INTERNAL=32768

# FreeRTOS - Use PSRAM for large stacks
CONFIG_FREERTOS_SUPPORT_STATIC_ALLOCATION=y
CONFIG_FREERTOS_PLACE_FUNCTIONS_INTO_FLASH=y

# Compiler optimization
CONFIG_COMPILER_OPTIMIZATION_PERF=y

# SPI Configuration
CONFIG_SPI_MASTER_ISR_IN_IRAM=y

# Logging: WARN - INFO logs share the USB channel with protocol responses
# (IMG_OK/FW_OK) and can corrupt ACK lines mid-transfer
CONFIG_LOG_DEFAULT_LEVEL_WARN=y

# FreeRTOS tick rate: at 100Hz, pdMS_TO_TICKS(1..9) truncates to 0 ticks
CONFIG_FREERTOS_HZ=1000

# Partition Table (Custom: OTA ota_0/ota_1 + LittleFS storage)
CONFIG_PARTITION_TABLE_CUSTOM=y
CONFIG_PARTITION_TABLE_CUSTOM_FILENAME="partitions.csv"
```
