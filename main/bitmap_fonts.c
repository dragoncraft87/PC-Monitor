#include "bitmap_fonts.h"

// Character mapping: Space, 0-9, A-Z, special chars
// Index calculation: Space=0, 0-9=1-10, A-Z=11-36, special chars after

int get_char_index(char c) {
    if (c == ' ') return 0;
    if (c >= '0' && c <= '9') return 1 + (c - '0');
    if (c >= 'A' && c <= 'Z') return 11 + (c - 'A');
    if (c >= 'a' && c <= 'z') return 11 + (c - 'a'); // lowercase = uppercase
    if (c == '%') return 37;
    if (c == '.') return 38;
    if (c == ':') return 39;
    if (c == '/') return 40;
    if (c == '-') return 41;
    if (c == '+') return 42;
    if (c == '°') return 43; // Degree symbol
    return 0; // Unknown = space
}

// ============================================================================
// 8x8 Font - Small font for labels
// ============================================================================
const uint8_t font_8x8[][8] = {
    // 0: Space
    {0x00, 0x00, 0x00, 0x00, 0x00, 0x00, 0x00, 0x00},
    
    // 1-10: Numbers 0-9
    {0x3C, 0x66, 0x66, 0x66, 0x66, 0x66, 0x3C, 0x00}, // 0
    {0x18, 0x38, 0x18, 0x18, 0x18, 0x18, 0x7E, 0x00}, // 1
    {0x3C, 0x66, 0x06, 0x0C, 0x18, 0x30, 0x7E, 0x00}, // 2
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    {0x3C, 0x66, 0x66, 0x3E, 0x06, 0x0C, 0x38, 0x00}, // 9
    
    // 11-36: Letters A-Z
    {0x3C, 0x66, 0x66, 0x7E, 0x66, 0x66, 0x66, 0x00}, // A
    {0x7C, 0x66, 0x66, 0x7C, 0x66, 0x66, 0x7C, 0x00}, // B
    {0x3C, 0x66, 0x60, 0x60, 0x60, 0x66, 0x3C, 0x00}, // C
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    {0x7E, 0x06, 0x0C, 0x18, 0x30, 0x60, 0x7E, 0x00}, // Z
    
    // 37-43: Special characters
    {0x66, 0x66, 0x3C, 0x18, 0x3C, 0x66, 0x66, 0x00}, // % (reuse X pattern)
    {0x00, 0x00, 0x00, 0x00, 0x00, 0x18, 0x18, 0x00}, // .
    {0x00, 0x18, 0x18, 0x00, 0x18, 0x18, 0x00, 0x00}, // :
    {0x02, 0x06, 0x0C, 0x18, 0x30, 0x60, 0x40, 0x00}, // /
    {0x00, 0x00, 0x00, 0x7E, 0x00, 0x00, 0x00, 0x00}, // -
    {0x18, 0x18, 0x7E, 0x18, 0x7E, 0x18, 0x18, 0x00}, // +
    {0x60, 0x90, 0x90, 0x60, 0x00, 0x00, 0x00, 0x00}, // ° degree
};

// ============================================================================
// 8x16 Font - Medium font for details
// ============================================================================
const uint8_t font_8x16[][16] = {
    // 0: Space
    {0x00, 0x00, 0x00, 0x00, 0x00, 0x00, 0x00, 0x00,
     0x00, 0x00, 0x00, 0x00, 0x00, 0x00, 0x00, 0x00},
    
    // 1-10: Numbers 0-9 (bigger, bolder)
    {0x3C, 0x7E, 0xC3, 0xC3, 0xC3, 0xC3, 0xC3, 0xC3,
     0xC3, 0xC3, 0xC3, 0xC3, 0xC3, 0x7E, 0x3C, 0x00}, // 0
    {0x18, 0x38, 0x78, 0x18, 0x18, 0x18, 0x18, 0x18,
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     0x3F, 0x03, 0x03, 0xC3, 0xC3, 0x7E, 0x3C, 0x00}, // 9
    
    // 11+: Important letters (C, G, M, P, U for "CPU", "GPU", "MB", etc.)
    {0x3C, 0x7E, 0xC3, 0xC3, 0xC3, 0xFF, 0xFF, 0xC3,
     0xC3, 0xC3, 0xC3, 0xC3, 0xC3, 0xC3, 0xC3, 0x00}, // A
    {0xFC, 0xFE, 0xC3, 0xC3, 0xC3, 0xC6, 0xFC, 0xFC,
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     0xC3, 0xC3, 0xC3, 0xC3, 0xC3, 0x7E, 0x3C, 0x00}, // G
    // ... Add more letters as needed
};

// ============================================================================
// 16x24 Font - Large (for percentages) - Only numbers
// ============================================================================
const uint8_t font_16x24[][48] = {
    // 0: Space
    {0x00,0x00, 0x00,0x00, 0x00,0x00, 0x00,0x00, 0x00,0x00, 0x00,0x00,
     0x00,0x00, 0x00,0x00, 0x00,0x00, 0x00,0x00, 0x00,0x00, 0x00,0x00,
     0x00,0x00, 0x00,0x00, 0x00,0x00, 0x00,0x00, 0x00,0x00, 0x00,0x00,
     0x00,0x00, 0x00,0x00, 0x00,0x00, 0x00,0x00, 0x00,0x00, 0x00,0x00},
    
    // Numbers 0-9 (simplified for now - would be larger bitmaps)
    // Just using scaled version of 8x16 for demo
};

// ============================================================================
// 16x32 Font - XLarge (for main values) - Only numbers
// ============================================================================
const uint8_t font_16x32[][64] = {
    // Similar structure, larger bitmaps
    // For now using placeholders
};
